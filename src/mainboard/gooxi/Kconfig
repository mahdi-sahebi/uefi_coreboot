## src/mainboard/gooxi/Kconfig
```kconfig
## SPDX-License-Identifier: GPL-2.0-only

if VENDOR_GOOXI

choice
	prompt "Mainboard model"

source "src/mainboard/gooxi/*/Kconfig.name"

endchoice

source "src/mainboard/gooxi/*/Kconfig"

config MAINBOARD_VENDOR
	default "Gooxi"

endif # VENDOR_GOOXI
```

## src/mainboard/gooxi/g4del/Kconfig
```kconfig
## SPDX-License-Identifier: GPL-2.0-only

if BOARD_GOOXI_G4DEL

config BOARD_SPECIFIC_OPTIONS
	def_bool y
	select BOARD_ROMSIZE_KB_65536
	select CPU_INTEL_SOCKET_LGA4677
	select CONSOLE_SERIAL
	select CONSOLE_OVERRIDE_LOGLEVEL
	select EDK2_DEBUG
	select EDK2_BOOT_MANAGER_ESCAPE
	select EDK2_HAVE_EFI_SHELL
	select EDK2_SERIAL_SUPPORT
	select IPMI_KCS
	select IPMI_KCS_ROMSTAGE
	select PLATFORM_USES_FSP2_X86_32
	select SOC_INTEL_SAPPHIRERAPIDS_SP
	select SUPERIO_ASPEED_AST2400
	select DRIVERS_ASPEED_AST2050
	select HAVE_ACPI_TABLES
	select HAVE_INTEL_FSP_REPO
	select HAVE_X86_64_SUPPORT
	select PAGE_TABLES_IN_CBFS
	select SOC_INTEL_COMMON_BLOCK_SPI
	select MAINBOARD_USES_IFD_GBE_REGION

config MAINBOARD_DIR
	default "gooxi/g4del"

config MAINBOARD_PART_NUMBER
	default "G4DEL"

config FMDFILE
	string
	default "src/mainboard/\$(CONFIG_MAINBOARD_DIR)/board.fmd"

config FSP_FD_PATH
	default "3rdparty/fsp/EagleStreamFspBinPkg/Fsp.fd"

config UART_FOR_CONSOLE
	default 1

config MAX_SOCKET
	int
	default 2

config DIMM_MAX
	int
	default 32

config BOOTSPLASH_REGION_LOGO_FILE
	string
	default "Documentation/coreboot_logo.bmp"

endif
```

## src/mainboard/gooxi/g4del/Kconfig.name
```kconfig
## SPDX-License-Identifier: GPL-2.0-only

config BOARD_GOOXI_G4DEL
	bool "G4DEL"
```
